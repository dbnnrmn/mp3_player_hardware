## my_buildroot_tree/board/test_board/test_board_defconfig
```kconfig
BR2_arm=y
BR2_TOOLCHAIN_BUILDROOT_GLIBC=y
BR2_PACKAGE_HOST_LINUX_HEADERS_CUSTOM_5_4=y
BR2_TOOLCHAIN_BUILDROOT_CXX=y
BR2_PACKAGE_HOST_GDB=y
BR2_PACKAGE_HOST_GDB_TUI=y
BR2_PACKAGE_HOST_GDB_SIM=y
BR2_TARGET_GENERIC_HOSTNAME="test_board"
BR2_TARGET_GENERIC_ISSUE="Welcome to test_board"
BR2_ROOTFS_DEVICE_CREATION_DYNAMIC_EUDEV=y
BR2_ROOTFS_OVERLAY="$(BR2_EXTERNAL_my_tree_PATH)/board/allwinner/suniv-f1c100s/rootfs $(BR2_EXTERNAL_my_tree_PATH)/board/test_board/rootfs"
BR2_ROOTFS_POST_IMAGE_SCRIPT="$(BR2_EXTERNAL_my_tree_PATH)/board/allwinner/generic/scripts/genimage.sh"
BR2_ROOTFS_POST_SCRIPT_ARGS="${BR2_TARGET_UBOOT_SPL_NAME}"
BR2_LINUX_KERNEL=y
BR2_LINUX_KERNEL_CUSTOM_VERSION=y
BR2_LINUX_KERNEL_CUSTOM_VERSION_VALUE="5.4.99"
BR2_LINUX_KERNEL_PATCH="$(BR2_EXTERNAL_my_tree_PATH)/board/allwinner/suniv-f1c100s/patch/linux"
BR2_LINUX_KERNEL_USE_CUSTOM_CONFIG=y
BR2_LINUX_KERNEL_CUSTOM_CONFIG_FILE="$(BR2_EXTERNAL_my_tree_PATH)/board/allwinner/suniv-f1c100s/linux.defconfig"
BR2_LINUX_KERNEL_DTS_SUPPORT=y
BR2_LINUX_KERNEL_CUSTOM_DTS_PATH="board/allwinner/suniv-f1c100s/devicetree/linux/suniv-f1c100s.dtsi $(BR2_EXTERNAL_my_tree_PATH)/board/test_board/devicetree/linux/devicetree.dts"
BR2_PACKAGE_GDB=y
BR2_PACKAGE_FSWEBCAM=y
BR2_PACKAGE_FB_TEST_APP=y
BR2_PACKAGE_UMTPRD=y
BR2_PACKAGE_TINYALSA=y
BR2_PACKAGE_LIBV4L=y
BR2_PACKAGE_LIBV4L_UTILS=y
BR2_PACKAGE_TSLIB=y
BR2_PACKAGE_HAVEGED=y
BR2_PACKAGE_UTIL_LINUX_UUIDD=y
BR2_TARGET_ROOTFS_CPIO=y
BR2_TARGET_ROOTFS_CPIO_GZIP=y
BR2_TARGET_ROOTFS_EXT2=y
BR2_TARGET_ROOTFS_EXT2_4=y
BR2_TARGET_ROOTFS_EXT2_SIZE="100M"
BR2_TARGET_ROOTFS_SQUASHFS=y
BR2_TARGET_UBOOT=y
BR2_TARGET_UBOOT_BUILD_SYSTEM_KCONFIG=y
BR2_TARGET_UBOOT_CUSTOM_VERSION=y
BR2_TARGET_UBOOT_CUSTOM_VERSION_VALUE="2020.07"
BR2_TARGET_UBOOT_PATCH="$(BR2_EXTERNAL_my_tree_PATH)/board/allwinner/suniv-f1c100s/patch/u-boot"
BR2_TARGET_UBOOT_USE_CUSTOM_CONFIG=y
BR2_TARGET_UBOOT_CUSTOM_CONFIG_FILE="$(BR2_EXTERNAL_my_tree_PATH)/board/test_board/test_board_uboot.defconfig"
BR2_TARGET_UBOOT_NEEDS_DTC=y
BR2_TARGET_UBOOT_SPL=y
BR2_TARGET_UBOOT_SPL_NAME="u-boot-sunxi-with-spl.bin"
BR2_TARGET_UBOOT_CUSTOM_DTS_PATH="$(BR2_EXTERNAL_my_tree_PATH)/board/allwinner/suniv-f1c100s/devicetree/uboot/suniv-f1c100s.dtsi $(BR2_EXTERNAL_my_tree_PATH)/board/test_board/devicetree/uboot/suniv-f1c100s-generic.dts"
BR2_PACKAGE_HOST_DOSFSTOOLS=y
BR2_PACKAGE_HOST_GENIMAGE=y
BR2_PACKAGE_HOST_MTOOLS=y
BR2_PACKAGE_HOST_PYTHON3=y
BR2_PACKAGE_HOST_PYTHON3_SSL=y
BR2_PACKAGE_HOST_UBOOT_TOOLS=y
BR2_PACKAGE_HOST_UBOOT_TOOLS_FIT_SUPPORT=y
BR2_PACKAGE_HOST_UBOOT_TOOLS_FIT_SIGNATURE_SUPPORT=y
```
